## Documentation/devicetree/bindings/pinctrl/nvidia,tegra238-pinmux-aon.yaml
```yaml
# SPDX-License-Identifier: (GPL-2.0-only OR BSD-2-Clause)
%YAML 1.2
---
$id: http://devicetree.org/schemas/pinctrl/nvidia,tegra238-pinmux-aon.yaml#
$schema: http://devicetree.org/meta-schemas/core.yaml#

title: NVIDIA Tegra238 AON Pinmux Controller

maintainers:
  - Thierry Reding <thierry.reding@gmail.com>
  - Jon Hunter <jonathanh@nvidia.com>

properties:
  compatible:
    const: nvidia,tegra238-pinmux-aon

  reg:
    maxItems: 1

patternProperties:
  "^pinmux(-[a-z0-9-]+)?$":
    type: object

    # pin groups
    additionalProperties:
      $ref: nvidia,tegra238-pinmux-common.yaml

      properties:
        nvidia,pins:
          items:
            enum: [ bootv_ctl_n_paa0, soc_gpio00_paa1, vcomp_alert_paa2,
                    pwm1_paa3, batt_oc_paa4, soc_gpio04_paa5,
                    soc_gpio25_paa6, soc_gpio26_paa7,
                    hdmi_cec_pbb0,
                    spi2_sck_pcc0, spi2_miso_pcc1, spi2_mosi_pcc2,
                    spi2_cs0_pcc3, spi2_cs1_pcc4, uart3_tx_pcc5,
                    uart3_rx_pcc6, gen2_i2c_scl_pcc7,
                    gen2_i2c_sda_pdd0, gen8_i2c_scl_pdd1,
                    gen8_i2c_sda_pdd2, touch_clk_pdd3, dmic1_clk_pdd4,
                    dmic1_dat_pdd5, soc_gpio19_pdd6, pwm2_pdd7,
                    pwm3_pee0, pwm7_pee1,
                    # drive groups (ordered PAA, PBB, PCC, PDD, PEE)
                    drive_bootv_ctl_n_paa0, drive_soc_gpio00_paa1,
                    drive_vcomp_alert_paa2, drive_pwm1_paa3,
                    drive_batt_oc_paa4, drive_soc_gpio04_paa5,
                    drive_soc_gpio25_paa6, drive_soc_gpio26_paa7,
                    drive_hdmi_cec_pbb0,
                    drive_spi2_sck_pcc0, drive_spi2_miso_pcc1,
                    drive_spi2_mosi_pcc2, drive_spi2_cs0_pcc3,
                    drive_spi2_cs1_pcc4, drive_uart3_tx_pcc5,
                    drive_uart3_rx_pcc6, drive_gen2_i2c_scl_pcc7,
                    drive_gen2_i2c_sda_pdd0, drive_gen8_i2c_scl_pdd1,
                    drive_gen8_i2c_sda_pdd2, drive_touch_clk_pdd3,
                    drive_dmic1_clk_pdd4, drive_dmic1_dat_pdd5,
                    drive_soc_gpio19_pdd6, drive_pwm2_pdd7,
                    drive_pwm3_pee0, drive_pwm7_pee1 ]

required:
  - compatible
  - reg

additionalProperties: false

examples:
  - |
    #include <dt-bindings/pinctrl/pinctrl-tegra.h>

    pinmux@c300000 {
      compatible = "nvidia,tegra238-pinmux-aon";
      reg = <0x0c300000 0x4000>;

      pinctrl-names = "cec";
      pinctrl-0 = <&cec_state>;

      cec_state: pinmux-cec {
        cec {
          nvidia,pins = "hdmi_cec_pbb0";
          nvidia,function = "hdmi_cec";
        };
      };
    };
...
```

## Documentation/devicetree/bindings/sound/cx2072x.txt
```
Conexant CX20721/CX20723/CX7601 audio CODEC

The devices support I2C only.

Required properties:

  - compatible : One of "cnxt,cx20721", "cnxt,cx20723", "cnxt,cx7601".

  - reg : the I2C address of the device for I2C, it should be <0x33>

Optional properties:

  - clocks : phandle and clock specifier for codec MCLK.
  - clock-names : Clock name string for 'clocks' attribute, should be "mclk".

CODEC output pins:
  "PORTA"	- Headphone
  "PORTG"	- Class-D output
  "PORTE"	- Line out

CODEC output pins for Conexant DSP chip:
  "AEC REF"	- AEC reference signal

CODEC input pins:
  "PORTB"	- Analog mic
  "PORTC"	- Digital mic
  "PORTD"	- Headset mic

Example:

codec: cx20721@33 {
	compatible = "cnxt,cx20721";
	reg = <0x33>;
	clocks = <&sco>;
	clock-names = "mclk";
};
```

## arch/ppc/platforms/83xx/Kconfig
```kconfig
config 83xx
	bool "PowerQUICC II Pro (83xx) Support"
	depends on 6xx

menu "Freescale 83xx options"
	depends on 83xx

choice
	prompt "Machine Type"
	depends on 83xx
	default MPC834x_SYS

config MPC834x_SYS
	bool "Freescale MPC834x SYS"
	help
	  This option enables support for the MPC 834x SYS evaluation board.

endchoice

config MPC834x
	bool
	depends on MPC834x_SYS
	default y

config PPC_GEN550
	bool
	depends on 83xx
	default y

endmenu
```

## drivers/input/keyboard/Kconfig
```kconfig
#
# Input core configuration
#
menuconfig INPUT_KEYBOARD
	bool "Keyboards" if EMBEDDED || !X86
	default y
	help
	  Say Y here, and a list of supported keyboards will be displayed.
	  This option doesn't affect the kernel.

	  If unsure, say Y.

if INPUT_KEYBOARD

config KEYBOARD_ATKBD
	tristate "AT keyboard" if !PC
	default y
	select SERIO
	select SERIO_LIBPS2
	select SERIO_I8042 if PC
	select SERIO_GSCPS2 if GSC
	help
	  Say Y here if you want to use a standard AT or PS/2 keyboard. Usually
	  you'll need this, unless you have a different type keyboard (USB, ADB
	  or other). This also works for AT and PS/2 keyboards connected over a
	  PS/2 to serial converter.

	  If unsure, say Y.

	  To compile this driver as a module, choose M here: the
	  module will be called atkbd.

config KEYBOARD_SUNKBD
	tristate "Sun Type 4 and Type 5 keyboard"
	select SERIO
	help
	  Say Y here if you want to use a Sun Type 4 or Type 5 keyboard,
	  connected either to the Sun keyboard connector or to an serial
	  (RS-232) port via a simple adapter.

	  To compile this driver as a module, choose M here: the
	  module will be called sunkbd.

config KEYBOARD_LKKBD
	tristate "DECstation/VAXstation LK201/LK401 keyboard"
	select SERIO
	help
	  Say Y here if you want to use a LK201 or LK401 style serial
	  keyboard. This keyboard is also useable on PCs if you attach
	  it with the inputattach program. The connector pinout is
	  described within lkkbd.c.

	  To compile this driver as a module, choose M here: the
	  module will be called lkkbd.

config KEYBOARD_XTKBD
	tristate "XT keyboard"
	select SERIO
	help
	  Say Y here if you want to use the old IBM PC/XT keyboard (or
	  compatible) on your system. This is only possible with a
	  parallel port keyboard adapter, you cannot connect it to the
	  keyboard port on a PC that runs Linux.

	  To compile this driver as a module, choose M here: the
	  module will be called xtkbd.

config KEYBOARD_NEWTON
	tristate "Newton keyboard"
	select SERIO
	help
	  Say Y here if you have a Newton keyboard on a serial port.

	  To compile this driver as a module, choose M here: the
	  module will be called newtonkbd.

config KEYBOARD_CORGI
	tristate "Corgi keyboard"
	depends on PXA_SHARPSL
	default y	
	help
	  Say Y here to enable the keyboard on the Sharp Zaurus SL-C7xx 
	  series of PDAs.

	  To compile this driver as a module, choose M here: the 
	  module will be called corgikbd.

config KEYBOARD_MAPLE
	tristate "Maple bus keyboard"
	depends on SH_DREAMCAST && MAPLE
	help
	  Say Y here if you have a DreamCast console running Linux and have
	  a keyboard attached to its Maple bus.

	  To compile this driver as a module, choose M here: the
	  module will be called maple_keyb.

config KEYBOARD_AMIGA
	tristate "Amiga keyboard"
	depends on AMIGA
	help
	  Say Y here if you are running Linux on any AMIGA and have a keyboard
	  attached.

	  To compile this driver as a module, choose M here: the
	  module will be called amikbd.

endif
```

## drivers/input/serio/Kconfig
```kconfig
#
# Input core configuration
#
config SERIO
	tristate "Serial I/O support" if EMBEDDED || !X86
	default y
	---help---
	  Say Yes here if you have any input device that uses serial I/O to
	  communicate with the system. This includes the
	  		* standard AT keyboard and PS/2 mouse *
	  as well as serial mice, Sun keyboards, some joysticks and 6dof
	  devices and more.

	  If unsure, say Y.

	  To compile this driver as a module, choose M here: the
	  module will be called serio.

if SERIO

config SERIO_I8042
	tristate "i8042 PC Keyboard controller" if EMBEDDED || !X86
	default y
	depends on !PARISC && (!ARM || ARCH_SHARK || FOOTBRIDGE_HOST) && !M68K
	---help---
	  i8042 is the chip over which the standard AT keyboard and PS/2
	  mouse are connected to the computer. If you use these devices,
	  you'll need to say Y here.

	  If unsure, say Y.

	  To compile this driver as a module, choose M here: the
	  module will be called i8042.

config SERIO_SERPORT
	tristate "Serial port line discipline"
	default y
	---help---
	  Say Y here if you plan to use an input device (mouse, joystick,
	  tablet, 6dof) that communicates over the RS232 serial (COM) port.

	  More information is available: <file:Documentation/input/input.txt>

	  If unsure, say Y.

	  To compile this driver as a module, choose M here: the
	  module will be called serport.

config SERIO_CT82C710
	tristate "ct82c710 Aux port controller"
	depends on !PARISC
	---help---
	  Say Y here if you have a Texas Instruments TravelMate notebook
	  equipped with the ct82c710 chip and want to use a mouse connected
	  to the "QuickPort".

	  If unsure, say N.

	  To compile this driver as a module, choose M here: the
	  module will be called ct82c710.

config SERIO_Q40KBD
	tristate "Q40 keyboard controller"
	depends on Q40

config SERIO_PARKBD
	tristate "Parallel port keyboard adapter"
	depends on PARPORT
	---help---
	  Say Y here if you built a simple parallel port adapter to attach
	  an additional AT keyboard, XT keyboard or PS/2 mouse.

	  More information is available: <file:Documentation/input/input.txt>

	  If unsure, say N.

	  To compile this driver as a module, choose M here: the
	  module will be called parkbd.

config SERIO_RPCKBD
	tristate "Acorn RiscPC keyboard controller"
	depends on ARCH_ACORN || ARCH_CLPS7500
	default y
	help
	  Say Y here if you have the Acorn RiscPC and want to use an AT
	  keyboard connected to its keyboard controller.

	  To compile this driver as a module, choose M here: the
	  module will be called rpckbd.

config SERIO_AMBAKMI
	tristate "AMBA KMI keyboard controller"
	depends on ARM_AMBA

config SERIO_SA1111
	tristate "Intel SA1111 keyboard controller"
	depends on SA1111

config SERIO_GSCPS2
	tristate "HP GSC PS/2 keyboard and PS/2 mouse controller"
	depends on GSC
	default y
	help
	  This driver provides support for the PS/2 ports on PA-RISC machines
	  over which HP PS/2 keyboards and PS/2 mice may be connected.
	  If you use these devices, you'll need to say Y here.

	  It's safe to enable this driver, so if unsure, say Y.

	  To compile this driver as a module, choose M here: the
	  module will be called gscps2.

config SERIO_PCIPS2
	tristate "PCI PS/2 keyboard and PS/2 mouse controller"
	depends on PCI
	help
	  Say Y here if you have a Mobility Docking station with PS/2
	  keyboard and mice ports.

	  To compile this driver as a module, choose M here: the
	  module will be called pcips2.

config SERIO_MACEPS2
	tristate "SGI O2 MACE PS/2 controller"
	depends on SGI_IP32
	help
	  Say Y here if you have SGI O2 workstation and want to use its
	  PS/2 ports.

	  To compile this driver as a module, choose M here: the
	  module will be called maceps2.

config SERIO_LIBPS2
	tristate "PS/2 driver library" if EMBEDDED
	help
	  Say Y here if you are using a driver for device connected
	  to a PS/2 port, such as PS/2 mouse or standard AT keyboard.

	  To compile this driver as a module, choose M here: the
	  module will be called libps2.

config SERIO_RAW
	tristate "Raw access to serio ports"
	help
	  Say Y here if you want to have raw access to serio ports, such as
	  AUX ports on i8042 keyboard controller. Each serio port that is
	  bound to this driver will be accessible via a char device with
	  major 10 and dynamically allocated minor. The driver will try
	  allocating minor 1 (that historically corresponds to /dev/psaux)
	  first. To bind this driver to a serio port use sysfs interface:

	      echo -n "serio_raw" > /sys/bus/serio/devices/serioX/driver

	  To compile this driver as a module, choose M here: the
	  module will be called serio_raw.

endif
```

## drivers/input/touchscreen/Kconfig
```kconfig
#
# Mouse driver configuration
#
menuconfig INPUT_TOUCHSCREEN
	bool "Touchscreens"
	help
	  Say Y here, and a list of supported touchscreens will be displayed.
	  This option doesn't affect the kernel.

	  If unsure, say Y.

if INPUT_TOUCHSCREEN

config TOUCHSCREEN_BITSY
	tristate "Compaq iPAQ H3600 (Bitsy) touchscreen input driver"
	depends on SA1100_BITSY
	select SERIO
	help
	  Say Y here if you have the h3600 (Bitsy) touchscreen.

	  If unsure, say N.

	  To compile this driver as a module, choose M here: the
	  module will be called h3600_ts_input.

config TOUCHSCREEN_GUNZE
	tristate "Gunze AHL-51S touchscreen"
	select SERIO
	help
	  Say Y here if you have the Gunze AHL-51 touchscreen connected to
	  your system.

	  If unsure, say N.

	  To compile this driver as a module, choose M here: the
	  module will be called gunze.

endif
```

## drivers/media/pci/intel/Kconfig
```kconfig
# SPDX-License-Identifier: GPL-2.0-only
source "drivers/media/pci/intel/ipu6/Kconfig

config IPU_BRIDGE
	tristate
	depends on ACPI || COMPILE_TEST
	depends on I2C
	help
	  This is a helper module for the IPU bridge, which can be
	  used by ipu3 and other drivers. In order to handle module
	  dependencies, this is selected by each driver that needs it.

source "drivers/media/pci/intel/ipu3/Kconfig"
source "drivers/media/pci/intel/ivsc/Kconfig"
```

## drivers/perf/hisilicon/Kconfig
```kconfig
# SPDX-License-Identifier: GPL-2.0-only
config HISI_PMU
	tristate "HiSilicon SoC PMU drivers"
	depends on ARM64 && ACPI
	  help
	  Support for HiSilicon SoC L3 Cache performance monitor, Hydra Home
	  Agent performance monitor and DDR Controller performance monitor.

config HNS3_PMU
	tristate "HNS3 PERF PMU"
	depends on ARM64 || COMPILE_TEST
	depends on PCI
	help
	  Provide support for HNS3 performance monitoring unit (PMU) RCiEP
	  devices.
	  Adds the HNS3 PMU into perf events system for monitoring latency,
	  bandwidth etc.
```

## drivers/platform/x86/intel/Kconfig
```kconfig
# SPDX-License-Identifier: GPL-2.0-only
#
# Intel x86 Platform Specific Drivers
#

menuconfig X86_PLATFORM_DRIVERS_INTEL
	bool "Intel x86 Platform Specific Device Drivers"
	default y
	help
	  Say Y here to get to see options for device drivers for
	  various Intel x86 platforms, including vendor-specific
	  drivers. This option alone does not add any kernel code.

	  If you say N, all options in this submenu will be skipped
	  and disabled.

if X86_PLATFORM_DRIVERS_INTEL

source "drivers/platform/x86/intel/int33fe/Kconfig"
source "drivers/platform/x86/intel/int3472/Kconfig"
source "drivers/platform/x86/intel/pmc/Kconfig"
source "drivers/platform/x86/intel/pmt/Kconfig"

config INTEL_SDSI
	tristate "Intel Software Defined Silicon Driver"
	depends on INTEL_VSEC
	depends on X86_64
	help
	  This driver enables access to the Intel Software Defined Silicon
	  interface used to provision silicon features with an authentication
	  certificate and capability license.

	  To compile this driver as a module, choose M here: the module will
	  be called intel_sdsi.

config INTEL_VSEC
	tristate "Intel Vendor Specific Extended Capabilities Driver"
	depends on PCI
	select AUXILIARY_BUS
	help
	  Adds support for feature drivers exposed using Intel PCIe VSEC and
	  DVSEC.

	  To compile this driver as a module, choose M here: the module will
	  be called intel_vsec.

endif # X86_PLATFORM_DRIVERS_INTEL
```

## fs/smb/Kconfig
```kconfig
# SPDX-License-Identifier: GPL-2.0-only
#
# smbfs configuration

source "fs/smb/client/Kconfig"

config SMBFS
       tristate
       default y if CIFS=y
       default m if CIFS=m
```
