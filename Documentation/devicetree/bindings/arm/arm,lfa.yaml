## Documentation/devicetree/bindings/arm/arm,lfa.yaml
```yaml
# SPDX-License-Identifier: (GPL-2.0-only OR BSD-2-Clause)
%YAML 1.2
---
$id: http://devicetree.org/schemas/arm/arm,lfa.yaml#
$schema: http://devicetree.org/meta-schemas/core.yaml#

title: Arm Live Firmware Activation (LFA)

maintainers:
  - Andre Przywara <andre.przywara@arm.com>
  - Sudeep Holla <sudeep.holla@arm.com>

description:
  The Arm Live Firmware Activation (LFA) specification [1] describes a
  firmware interface to activate an updated firmware at runtime, without
  requiring a reboot. Updates might be supplied out-of-band, for instance
  via a BMC, in which case the platform needs to notify an OS about pending
  image updates.
  [1] https://developer.arm.com/documentation/den0147/latest/

properties:
  compatible:
    const: arm,lfa

  interrupts:
    maxItems: 1
    description: notification interrupt for changed firmware image status

required:
  - compatible
  - interrupts

additionalProperties: false

examples:
  - |
    #include <dt-bindings/interrupt-controller/arm-gic.h>

    firmware {
        firmware-update {
            compatible = "arm,lfa";
            interrupts = <GIC_SPI 123 IRQ_TYPE_LEVEL_HIGH>;
        };
    };
...
```
